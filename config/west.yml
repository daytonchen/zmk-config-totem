## config/west.yml
```yaml
manifest:
  remotes:
    - name: zmkfirmware
      url-base: https://github.com/zmkfirmware
    - name: urob
      url-base: https://github.com/urob
    - name: bildermankawasaki
      url-base: https://github.com/bildermankawasaki
  projects:
    - name: zmk
      remote: zmkfirmware
      revision: v0.3
      import: app/west.yml


    # trying BildermanKawasaki's totem module
    - name: zmk-keyboard-totem
      remote: bildermankawasaki
      revision: main
    
    # urob modules for zmk, stashing here for now
    - name: zmk-adaptive-key
      remote: urob
      revision: v0.3
      path: modules/zmk/adaptive-key
    - name: zmk-auto-layer
      remote: urob
      revision: v0.3
      path: modules/zmk/auto-layer
    - name: zmk-helpers
      remote: urob
      revision: v0.3
      path: modules/zmk/helpers
    - name: zmk-leader-key
      remote: urob
      revision: v0.3
      path: modules/zmk/leader-key
    - name: zmk-tri-state
      remote: urob
      revision: v0.3

      path: modules/zmk/tri-state
  self:
    path: config
```
